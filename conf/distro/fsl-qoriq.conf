## conf/distro/fsl-qoriq.conf
```bitbake
require conf/distro/poky.conf

DISTRO = "fsl-qoriq"
DISTRO_NAME = "QorIQ SDK (FSL Reference Distro)"
MAINTAINER = "Freescale Yocto Team <meta-freescale@yoctoproject.org>"

TARGET_VENDOR = "-fsl"

SDK_VENDOR = "-fslsdk"
SDK_NAME_PREFIX = "${DISTRO}"

POKY_DEFAULT_DISTRO_FEATURES:remove = " ptest"
DISTRO_FEATURES:append = " vpp opengl pam virtualization polkit ipv6 security"
DISTRO_FEATURES_BACKFILL_CONSIDERED:append:qoriq-ppc = " gobject-introspection-data"
MACHINE_FEATURES_BACKFILL_CONSIDERED:append:e500v2 = " qemu-usermode"

LICENSE_FLAGS_ACCEPTED = "non-commercial_netperf"

PREFERRED_PROVIDER_qemu = "qemu-qoriq"

PREFERRED_VERSION_virtual/nativesdk-libiconv = "2.20"
PREFERRED_VERSION_tcpreplay = "3.4.4"
PREFERRED_PROVIDER_virtual/kernel = "linux-qoriq"
LTTNGUST:qoriq = ""
LTTNGTOOLS:qoriq = ""
LTTNGMODULES:qoriq = ""
MACHINE_HAS_VIVANTE_KERNEL_DRIVER_SUPPORT = "1"
SOC_DEFAULT_IMAGE_FSTYPES:remove = " wic.bz2 tar.bz2"
SOC_DEFAULT_IMAGE_FSTYPES:append = " cpio.gz cpio.gz.u-boot"

## Overwrite weak default in meta-freescale
KERNEL_IMAGETYPE:qoriq-arm ?= "uImage"

SERIAL_CONSOLES:qoriq-arm ?= "115200;ttyS0 115200;ttyS1 115200;ttyEHV0 115200;ttyLP0 115200;ttyAMA0"
SERIAL_CONSOLES:qoriq-arm64 ?= "115200;ttyS0 115200;ttyS1 115200;ttyAMA0"
```

## conf/layer.conf
```bitbake
# We have a conf and classes directory, add to BBPATH
BBPATH .= ":${LAYERDIR}"

# We have a packages directory, add to BBFILES
BBFILES += "${LAYERDIR}/recipes-*/*/*.bb \
            ${LAYERDIR}/recipes-*/*/*.bbappend"

BBFILE_COLLECTIONS += "meta-qoriq"
BBFILE_PATTERN_meta-qoriq := "^${LAYERDIR}/"
BBFILE_PRIORITY_meta-qoriq = "8"
LAYERSERIES_COMPAT_meta-qoriq = "honister kirkstone langdale mickledore master nanbield"

HOSTTOOLS_NONFATAL:append = " whoami sha384sum xxd realpath"


# Define new EULAs and add them to the list defined in meta-freescale.
# See fsl-eula-unpack.bbclass.
FSL_EULA_FILE_MD5SUM_LA_OPT_NXP_SOFTWARE_LICENSE_V36 = "b54da624b8d2ffe8a3b47757da48e60f"
FSL_EULA_FILE_MD5SUM_LA_OPT_NXP_SOFTWARE_LICENSE_V37 = "37cb2d8c2bcf8bf2fbe0366d5d928c29"
FSL_EULA_FILE_MD5SUM_LA_OPT_NXP_SOFTWARE_LICENSE_V38 = "65c483bb431ccd9a1820e6872c604771"
FSL_EULA_FILE_MD5SUM_LA_OPT_NXP_SOFTWARE_LICENSE_V39 = "5a0bf11f745e68024f37b4724a5364fe"
FSL_EULA_FILE_MD5SUM_LA_OPT_NXP_SOFTWARE_LICENSE_V40 = "add2d392714d3096ed7e0f7e2190724b"
FSL_EULA_FILE_MD5SUM_LA_OPT_NXP_SOFTWARE_LICENSE_V42 = "ea25d099982d035af85d193c88a1b479"
FSL_EULA_FILE_MD5SUM_LA_OPT_NXP_SOFTWARE_LICENSE_V44 = "d7853b7bf2936b2c25c893eac7033374"
FSL_EULA_FILE_MD5SUM_LA_OPT_NXP_SOFTWARE_LICENSE_V45 = "63a38e9f392d8813d6f1f4d0d6fbe657"
FSL_EULA_FILE_MD5SUM_LA_OPT_NXP_SOFTWARE_LICENSE_V48 = "db4762b09b6bda63da103963e6e081de"

FSL_EULA_FILE_MD5SUMS:append = " \
    ${FSL_EULA_FILE_MD5SUM_LA_OPT_NXP_SOFTWARE_LICENSE_V36} \
    ${FSL_EULA_FILE_MD5SUM_LA_OPT_NXP_SOFTWARE_LICENSE_V37} \
    ${FSL_EULA_FILE_MD5SUM_LA_OPT_NXP_SOFTWARE_LICENSE_V38} \
    ${FSL_EULA_FILE_MD5SUM_LA_OPT_NXP_SOFTWARE_LICENSE_V39} \
    ${FSL_EULA_FILE_MD5SUM_LA_OPT_NXP_SOFTWARE_LICENSE_V40} \
    ${FSL_EULA_FILE_MD5SUM_LA_OPT_NXP_SOFTWARE_LICENSE_V42} \
    ${FSL_EULA_FILE_MD5SUM_LA_OPT_NXP_SOFTWARE_LICENSE_V44} \
    ${FSL_EULA_FILE_MD5SUM_LA_OPT_NXP_SOFTWARE_LICENSE_V45} \
    ${FSL_EULA_FILE_MD5SUM_LA_OPT_NXP_SOFTWARE_LICENSE_V48} \
"

BBFILES_DYNAMIC += " \
    virtualization-layer:${LAYERDIR}/dynamic-layers/virtualization-layer/*/*/*.bb \
    virtualization-layer:${LAYERDIR}/dynamic-layers/virtualization-layer/*/*/*.bbappend \
"
# The Kernel community has re-organized ARMv7 DTS path in the arch/arm/boot/dts.
KERNEL_DEVICETREE:ls1021atwr = "nxp/ls/ls1021a-twr.dtb"
KERNEL_DEVICETREE:ls1021aqds = "nxp/ls/ls1021a-qds.dtb"

# Reset INITRAMFS_IMAGE_NAME from kernel-fitimage.bbclas
# INITRAMFS_IMAGE_NAME ?= "${@['${INITRAMFS_IMAGE}${IMAGE_MACHINE_SUFFIX}', ''][d.getVar('INITRAMFS_IMAGE') == '']}"
INITRAMFS_IMAGE_NAME="${INITRAMFS_IMAGE}${IMAGE_MACHINE_SUFFIX}${IMAGE_NAME_SUFFIX}"

DISTRO_FEATURES:remove = "vpp"
```

## conf/machine/include/qoriq-ppc.inc
```bitbake
# Provides the common settings for QorIQ PPC

KERNEL_IMAGETYPE ?= "uImage"

SERIAL_CONSOLES ?= "115200;ttyS0 115200;ttyS1 115200;ttyEHV0"
SERIAL_CONSOLES_CHECK ?= "${SERIAL_CONSOLES}"

MACHINEOVERRIDES =. "qoriq-ppc:"

require conf/machine/include/qoriq-base.inc

GCCVERSION_qoriq-ppc = "4.9.2"
BINUVERSION_qoriq-ppc = "2.25"
GLIBCVERSION_qoriq-ppc = "2.20"
PREFERRED_VERSION_virtual/nativesdk-libiconv = "2.20"
```

## conf/machine/ls1043ardb-be.conf
```bitbake
#@TYPE: Machine
#@NAME: Freescale LS1043ARDB 
#@SOC: LSCH2
#@DESCRIPTION: Machine configuration for running LS1043A in 64-bit mode
#@MAINTAINER: Chunrong Guo <nxa13725@nxp.com>

DEFAULTTUNE = "aarch64_be"

require conf/machine/include/qoriq-arm64.inc
require conf/machine/include/arm/arch-arm64.inc

SOC_FAMILY = "fsl-lsch2"

UBOOT_CONFIG ??= "nand sdcard nor"
UBOOT_CONFIG[nor] = "ls1043ardb_config,,u-boot-dtb.bin"
UBOOT_CONFIG[nand] = "ls1043ardb_nand_config,,u-boot-with-spl-pbl.bin"
UBOOT_CONFIG[sdcard] = "ls1043ardb_sdcard_config,,u-boot-with-spl-pbl.bin"
UBOOT_CONFIG[secure-boot] = "ls1043ardb_SECURE_BOOT_defconfig,,u-boot-dtb.bin"

QE_UCODE = "iram_Type_A_LS1021a_r1.0.bin"
LE_UBOOT_FOR_ARMBE_TARGET = "1"

KERNEL_DEVICETREE ?= "freescale/fsl-ls1043a-rdb.dtb"
KERNEL_DEFCONFIG ?= "defconfig"

EXTRA_IMAGEDEPENDS += "rcw qe-ucode"

USE_VT = "0"
```

## conf/machine/lx2160abluebox3.conf
```bitbake
#@TYPE: Machine
#@NAME: NXP LX2160ABLUEBOX3
#@SOC: LSCH3
#@DESCRIPTION: Machine configuration for running LX2160ABLUEBOX3 in 64-bit mode
#@MAINTAINER: Zongchun Yu <Zongchun.Yu@nxp.com>

require conf/machine/include/qoriq-arm64.inc
require conf/machine/include/arm/arch-arm64.inc

MACHINEOVERRIDES =. "fsl-lsch3:lx2160a:"

MACHINE_FEATURES += "optee"

KERNEL_CLASSES  = " kernel-fitimage "
KERNEL_IMAGETYPES = "fitImage"

DTB_LOAD = "0x90000000"
UBOOT_ENTRYPOINT = "0x80080000"

UBOOT_CONFIG ??= "tfa-secure-boot tfa"
UBOOT_CONFIG[tfa] = "lx2160abluebox3_tfa_defconfig,,u-boot-dtb.bin"
UBOOT_CONFIG[tfa-secure-boot] = "lx2160abluebox3_tfa_SECURE_BOOT_defconfig,,u-boot-dtb.bin"

KERNEL_DEVICETREE ?= "freescale/fsl-lx2160a-bluebox3.dtb"
KERNEL_DEFCONFIG ?= "defconfig"

SERIAL_CONSOLES ?= "115200;ttyS0 115200;ttyS1 115200;ttyAMA0"
SERIAL_CONSOLES_CHECK ?= "${SERIAL_CONSOLES}"

RCWXSPI ?= "PPUUPPUU_PP_RR_10a_2_2/rcw_2200_750_3200_10a_2_2"
RCWSD ?= "PPUUPPUU_PP_RR_10a_2_2/rcw_2200_750_3200_10a_2_2"
RCWEMMC ?= "PPUUPPUU_PP_RR_10a_2_2/rcw_2200_750_3200_10a_2_2"

EXTRA_IMAGEDEPENDS += "management-complex mc-utils rcw ddr-phy atf inphi"
USE_VT = "0"
```

## conf/machine/lx2160ahpcsom.conf
```bitbake
#@TYPE: Machine
#@NAME: NXP LX2160AHPCSOM
#@SOC: LSCH3
#@DESCRIPTION: Machine configuration for running LX2160AHPCSOM in 64-bit mode
#@MAINTAINER: Yangbo Lu <yangbo.lu@nxp.com>

require conf/machine/include/qoriq-arm64.inc
require conf/machine/include/arm/arch-arm64.inc

MACHINEOVERRIDES =. "fsl-lsch3:lx2160a:"

MACHINE_FEATURES += "optee"

KERNEL_CLASSES  = " kernel-fitimage "
KERNEL_IMAGETYPES = "fitImage"

DTB_LOAD = "0x90000000"
UBOOT_ENTRYPOINT = "0x80080000"

UBOOT_CONFIG ??= "tfa-secure-boot tfa"
UBOOT_CONFIG[tfa] = "lx2160ahpcsom_tfa_defconfig,,u-boot-dtb.bin"
UBOOT_CONFIG[tfa-secure-boot] = "lx2160ahpcsom_tfa_SECURE_BOOT_defconfig,,u-boot-dtb.bin"

KERNEL_DEVICETREE ?= "freescale/fsl-lx2160a-hpcsom.dtb"
KERNEL_DEFCONFIG ?= "defconfig"

SERIAL_CONSOLES ?= "115200;ttyS0 115200;ttyS1 115200;ttyAMA0"
SERIAL_CONSOLES_CHECK ?= "${SERIAL_CONSOLES}"

RCWSD ?= "PPPPPPPP_SSSSPPPP_RR_1_10_0/rcw_2200_750_3200_1_10_0"
RCWEMMC ?= "PPPPPPPP_SSSSPPPP_RR_1_10_0/rcw_2200_750_3200_1_10_0"

EXTRA_IMAGEDEPENDS += "management-complex mc-utils rcw ddr-phy atf"
USE_VT = "0"
```

## conf/machine/lx2162aqds.conf
```bitbake
#@TYPE: Machine
#@NAME: NXP LX2162AQDS
#@SOC: LSCH3
#@DESCRIPTION: Machine configuration for running LX2162AQDS in 64-bit mode
#@MAINTAINER: Chunrong Guo <Chunrong.Guo@nxp.com>

require conf/machine/include/qoriq-arm64.inc
require conf/machine/include/arm/arch-arm64.inc

MACHINEOVERRIDES =. "fsl-lsch3:lx2162a:"

MACHINE_FEATURES += "optee"

KERNEL_CLASSES  = " kernel-fitimage "
KERNEL_IMAGETYPES = "fitImage"

DTB_LOAD = "0x90000000"
UBOOT_ENTRYPOINT = "0x80080000"

UBOOT_CONFIG ??= "tfa-secure-boot tfa"
UBOOT_CONFIG[tfa] = "lx2162aqds_tfa_defconfig,,u-boot-dtb.bin"
UBOOT_CONFIG[tfa-secure-boot] = "lx2162aqds_tfa_SECURE_BOOT_defconfig,,u-boot-dtb.bin"

KERNEL_DEVICETREE ?= "freescale/fsl-lx2162a-qds.dtb"
KERNEL_DEFCONFIG ?= "defconfig"

SERIAL_CONSOLES ?= "115200;ttyS0 115200;ttyS1 115200;ttyAMA0"
SERIAL_CONSOLES_CHECK ?= "${SERIAL_CONSOLES}"

RCWXSPI ?= "FFGG_NNNN_PPPP_HHHH_RR_18_5/rcw_2000_650_2900_18_5"
RCWSD ?= "FFGG_NNNN_PPPP_HHHH_RR_18_5/rcw_2000_650_2900_18_5"
RCWEMMC ?= "FFGG_NNNN_PPPP_HHHH_RR_18_5/rcw_2000_650_2900_18_5"

EXTRA_IMAGEDEPENDS += "management-complex mc-utils rcw ls2-phy ddr-phy atf inphi"
USE_VT = "0"
```

## meta-qoriq-sdk/recipes-fsl/images/fsl-image-kernelitb/kernel-arm32.its
```
/*
 * Copyright 2017 NXP
 *
 */


/dts-v1/;

/ {
	description = "Image file for the QorIQ ARM 32b Linux Kernel";
	#address-cells = <1>;

	images {
		kernel-v7 {
			description = "ARM32 Linux kernel";
			data = /incbin/("zImage");
			type = "kernel";
			arch = "arm";
			os = "linux";
			compression = "none";
			load = <0x80008000>;
			entry = <0x80008000>;
		};

		initrd {
			description = "initrd for arm32";
			data = /incbin/("rootfs.cpio.gz");
			type = "ramdisk";
			arch = "arm";
			os = "linux";
			compression = "none";
		};


		ls1021atwr-dtb {
			description = "Flattened Device Tree blob";
			data = /incbin/("freescale.dtb");
			type = "flat_dt";
			arch = "arm";
			compression = "none";
			load = <0x90000000>;
		};


	};

	configurations {
		ls1021atwr {
			description = "Boot Linux kernel";
			kernel = "kernel-v7";
			fdt = "ls1021atwr-dtb";
			ramdisk = "initrd";
		};
	};
};
```

## meta-qoriq-sdk/recipes-fsl/images/fsl-image-kernelitb/kernel-arm64.its
```
/*
 * Copyright 2017 NXP
 *
 */


/dts-v1/;

/ {
	description = "arm64 kernel, ramdisk and FDT blob";
	#address-cells = <1>;

	images {
		kernel {
			description = "ARM64 Kernel";
			data = /incbin/("kernel-image.gz");
			type = "kernel";
			arch = "arm64";
			os = "linux";
			compression = "gzip";
			load = <0x84080000>;
			entry = <0x84080000>;
			hash-1 {
				algo = "crc32";
			};
		};

		initrd {
			description = "initrd for arm64";
			data = /incbin/("rootfs.cpio.gz");
			type = "ramdisk";
			arch = "arm64";
			os = "linux";
			compression = "none";
			load = <0x00000000>;
			entry = <0x00000000>;
			hash-1 {
				algo = "crc32";
			};
		};

		fdt-dtb {
			description = "nxp-dtb";
			data = /incbin/("freescale.dtb");
			type = "flat_dt";
			arch = "arm64";
			os = "linux";
			compression = "none";
			load = <0x90000000>;
			hash-1 {
				algo = "crc32";
			};
		};


	};

	configurations {
		ls1028ardb {
			description = "config for ls1028ardb";
			kernel = "kernel";
			ramdisk = "initrd";
			fdt = "fdt-dtb";
		};

		ls1028aqds {
			description = "config for ls1028aqds";
			kernel = "kernel";
			ramdisk = "initrd";
			fdt = "fdt-dtb";
		};

		ls2080ardb {
			description = "config for ls2080ardb";
			kernel = "kernel";
			ramdisk = "initrd";
			fdt = "fdt-dtb";
		};

		ls2088ardb {
			description = "config for ls2088ardb";
			kernel = "kernel";
			ramdisk = "initrd";
			fdt = "fdt-dtb";
		};

		ls1088ardb {
			description = "config for ls1088ardb";
			kernel = "kernel";
			ramdisk = "initrd";
			fdt = "fdt-dtb";
		};

		ls1043ardb {
			description = "config for ls1043ardb";
			kernel = "kernel";
			ramdisk = "initrd";
			fdt = "fdt-dtb";
		};

		ls1046ardb {
			description = "config for ls1046ardb";
			kernel = "kernel";
			ramdisk = "initrd";
			fdt = "fdt-dtb";
		};

                ls1046afrwy {
			description = "config for ls1046afrwy";
			kernel = "kernel";
			ramdisk = "initrd";
			fdt = "fdt-dtb";
		};

		ls1012ardb {
			description = "config for ls1012ardb";
			kernel = "kernel";
			ramdisk = "initrd";
			fdt = "fdt-dtb";
		};

		ls1012afrwy {
			description = "config for ls1012afrwy";
			kernel = "kernel";
			ramdisk = "initrd";
			fdt = "fdt-dtb";
		};

		lx2160ardb {
			description = "config for lx2160ardb";
			kernel = "kernel";
			ramdisk = "initrd";
			fdt = "fdt-dtb";
		};
		lx2162aqds {
			description = "config for lx2162aqds";
			kernel = "kernel";
			ramdisk = "initrd";
			fdt = "fdt-dtb";
		};
	};
};
```

## recipes-bsp/verified-boot/files/kernel.its
```
/*
 * copyright 2020 NXP
 *
 */

/dts-v1/;

/ {
        description = "arm64 kernel, ramdisk and FDT blob";
        #address-cells = <1>;

        images {
                kernel {
                        description = "ARM64 Kernel";
                        data = /incbin/("kernel-image.gz");
                        type = "kernel";
                        arch = "arm64";
                        os = "linux";
                        compression = "gzip";
                        load = <0x81080000>;
                        entry = <0x81080000>;
                        hash {
                                algo = "sha1";
                        };
                        signature {
                                algo = "sha1,rsa2048";
                                key-name-hint = "dev";
                        };
                };

                dtb {
                        description = "Device Tree blob";
                        data = /incbin/("freescale.dtb");
                        type = "flat_dt";
                        arch = "arm64";
                        os = "linux";
                        compression = "none";
                        load = <0x90000000>;
                        hash {
                                algo = "sha1";
                        };
                        signature {
                                algo = "sha1,rsa2048";
                                key-name-hint = "dev";
                        };
                };
                initrd {
                        description = "initrd for arm64";
                        data = /incbin/("rootfs.cpio.gz");
                        type = "ramdisk";
                        arch = "arm64";
                        os = "linux";
                        compression = "none";
                        load = <0x00000000>;
                        entry = <0x00000000>;
                        hash {
                                algo = "sha1";
                        };
                        signature {
                                algo = "sha1,rsa2048";
                                key-name-hint = "dev";
                        };
                };

        };

        configurations {
                default = "lx2162aqds";
                lx2162aqds {
                        description = "config for lx2162aqds";
                        kernel = "kernel";
                        ramdisk = "initrd";
                        fdt = "dtb";
                        signature {
                                algo = "sha1,rsa2048";
                                key-name-hint = "dev";
                                sign-images = "kernel", "fdt","ramdisk";
                        };
                };
        };
};
```
