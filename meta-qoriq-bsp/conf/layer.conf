## meta-qoriq-sdk/conf/layer.conf
```bitbake
# We have a conf and classes directory, add to BBPATH
BBPATH .= ":${LAYERDIR}"

# We have a packages directory, add to BBFILES
BBFILES += "${LAYERDIR}/recipes-*/*/*.bb \
            ${LAYERDIR}/recipes-*/*/*.bbappend"

BBFILE_COLLECTIONS += "meta-qoriq"
BBFILE_PATTERN_meta-qoriq := "^${LAYERDIR}/"
BBFILE_PRIORITY_meta-qoriq = "8"
LAYERSERIES_COMPAT_meta-qoriq = "honister kirkstone langdale mickledore master nanbield scarthgap"

LAYERSERIES_COMPAT_security = "nanbield scarthgap"

HOSTTOOLS_NONFATAL:append = " whoami sha384sum xxd realpath"

BBFILES_DYNAMIC += " \
    virtualization-layer:${LAYERDIR}/dynamic-layers/virtualization-layer/*/*/*.bb \
    virtualization-layer:${LAYERDIR}/dynamic-layers/virtualization-layer/*/*/*.bbappend \
"
```
